## os/Config.in
```kconfig
source "$BR2_EXTERNAL_BEINGOS_PATH/package/being/Config.in"
source "$BR2_EXTERNAL_BEINGOS_PATH/package/being-backup-age/Config.in"
source "$BR2_EXTERNAL_BEINGOS_PATH/package/cortex/Config.in"
source "$BR2_EXTERNAL_BEINGOS_PATH/package/pocketsphinx/Config.in"
source "$BR2_EXTERNAL_BEINGOS_PATH/package/sherpa-onnx/Config.in"
```

## os/package/being-backup-age/Config.in
```kconfig
config BR2_PACKAGE_BEING_BACKUP_AGE
	bool "age backup encryption"
	depends on BR2_x86_64
	help
	  Native X25519 backup encryption and key tools from the upstream
	  static amd64 Linux release of age.

	  https://age-encryption.org/
```

## os/package/being-turbostat/Config.in
```kconfig
config BR2_PACKAGE_BEING_TURBOSTAT
	bool "turbostat from the selected Linux kernel"
	depends on BR2_i386 || BR2_x86_64
	depends on BR2_LINUX_KERNEL
	depends on BR2_USE_MMU
	select BR2_PACKAGE_LIBCAP
	help
	  Build turbostat from the exact pinned Linux source tree used for the
	  diagnostic kernel. No independent userspace source is downloaded.
```

## os/package/being/Config.in
```kconfig
config BR2_PACKAGE_BEING
	bool "being"
	depends on BR2_PACKAGE_HOST_RUSTC_TARGET_ARCH_SUPPORTS
	depends on BR2_PACKAGE_SDL2_KMSDRM
	depends on BR2_PACKAGE_PYTHON3_SQLITE
	depends on BR2_USE_WCHAR
	depends on BR2_INSTALL_LIBSTDCPP
	depends on BR2_TOOLCHAIN_HAS_THREADS
	depends on !BR2_STATIC_LIBS
	depends on BR2_TOOLCHAIN_GCC_AT_LEAST_7
	select BR2_PACKAGE_HOST_RUSTC
	select BR2_PACKAGE_JPEG
	# The confined Keep PDF worker uses only /usr/bin/pdftotext. Buildroot's
	# upstream Poppler package owns the source/hash pin and installs the tools.
	select BR2_PACKAGE_POPPLER
	select BR2_PACKAGE_POPPLER_UTILS
	select BR2_PACKAGE_SMARTMONTOOLS
	help
	  The being's organs: the face, the brainstem and the mind, with
	  the systemd units that start them at boot.

comment "being needs SDL2 KMS/DRM, Python SQLite, and a dynamic C++17 toolchain with threads and wchar"
	depends on !BR2_PACKAGE_SDL2_KMSDRM || !BR2_PACKAGE_PYTHON3_SQLITE || \
		!BR2_USE_WCHAR || !BR2_INSTALL_LIBSTDCPP || !BR2_TOOLCHAIN_HAS_THREADS || \
		BR2_STATIC_LIBS || !BR2_TOOLCHAIN_GCC_AT_LEAST_7

config BR2_PACKAGE_BEING_LAB_BODY
	bool "lab body"
	depends on BR2_PACKAGE_BEING
	help
	  For images that run in a virtual machine with no microphone or
	  speakers yet: the second serial line (ttyS1) becomes its ears
	  and voice. What is typed there is heard; what it says is
	  printed there. Not for the laptop.

config BR2_PACKAGE_BEING_STOCK_SPEECH
	bool "install the staged Pip stock speech bank"
	depends on BR2_PACKAGE_BEING
	help
	  Include the approved bank from out/stock-speech in the system slot.
	  The host post-build step validates the exact clause set and WAVs.
	  Generate the bank with lab/build_stock_speech.py using the shipping voice.

config BR2_PACKAGE_BEING_LAN_MAINTENANCE
	bool "paired LAN maintenance"
	default y
	depends on BR2_PACKAGE_BEING
	depends on BR2_PACKAGE_OPENSSH_SERVER
	help
	  The owner-enrolled, key-only LAN observation and time-limited
	  development logins: being-lab-access, its two systemd units
	  and the restricted being-observe account. Nothing listens
	  until the owner runs being-lab-access enroll. The default
	  laptop image leaves this out; the owner opts in at build time.

config BR2_PACKAGE_BEING_CABLE_DEV
	bool "cable development link"
	depends on BR2_PACKAGE_BEING
	depends on BR2_PACKAGE_OPENSSH_SERVER
	help
	  For a development Try stick only (BEING_LAPTOP_CABLE=1
	  lab/build.sh laptop-try): on a Try boot the first wired port
	  gets 169.254.77.1 and fe80::77:1, and root can log in over
	  SSH from the Mac on the other end of the cable with one baked-in
	  Ed25519 key, from link-local addresses only. The being's code
	  becomes a writable copy for that boot. being.cable=0 on the
	  kernel command line switches it off. Such a stick never installs,
	  never becomes an ISO and is never signed as an update; the image
	  holds its SSH host key, so keep it private.

config BR2_PACKAGE_BEING_DIAGNOSTIC
	bool "Try-only hardware maintenance image"
	depends on BR2_PACKAGE_BEING
	help
	  Marks the isolated WP-C8 laptop diagnostic image. This option is
	  selected only by BEING_LAPTOP_DIAGNOSTIC=1 in lab/build.sh; board
	  packaging removes installation support and enables a local root
	  console. It must never be enabled in a shipping or update image.
```

## os/package/cortex/Config.in
```kconfig
config BR2_PACKAGE_CORTEX
	bool "cortex"
	depends on BR2_INSTALL_LIBSTDCPP
	depends on BR2_TOOLCHAIN_HAS_THREADS
	depends on BR2_TOOLCHAIN_GCC_AT_LEAST_9
	depends on BR2_USE_WCHAR
	help
	  The being's language model server: llama.cpp's llama-server,
	  built for the laptop's CPU. Buildroot's own llama-cpp package
	  leaves the instruction set to llama.cpp's cross-compile
	  defaults, which turn on AVX2. That binary would crash on an
	  Ivy Bridge CPU, so this package sets every flag itself.

	  https://github.com/ggml-org/llama.cpp
```

## os/package/piper-phonemize/Config.in
```kconfig
config BR2_PACKAGE_PIPER_PHONEMIZE
	bool "piper-phonemize"
	default y if BR2_PACKAGE_SHERPA_ONNX
	depends on BR2_x86_64
	depends on BR2_TOOLCHAIN_USES_GLIBC
	depends on BR2_INSTALL_LIBSTDCPP
	depends on BR2_TOOLCHAIN_HAS_THREADS
	help
	  Piper's phonemizer, for the natural voice. sherpa-onnx 2.0
	  and later no longer contain espeak-ng, so a Piper voice needs
	  its text turned into phonemes first; mind/phonemize.py loads
	  this library through ctypes and passes the result to
	  sherpa-onnx as phoneme codepoints.

	  This installs the upstream prebuilt linux-x64-shared release
	  (libpiper_phonemize_core.so, with espeak-ng linked statically
	  and its symbols hidden), pinned by sha256. It was built for
	  glibc 2.17 and generic x86-64, and needs libstdc++.

	  The pronunciation data (espeak-ng-data) is not installed here:
	  it is part of the voice pack on /models, which the voice checks
	  before loading.

	  Licences: GPL-3.0-or-later (piper-phonemize and espeak-ng),
	  installed to /usr/share/licenses/piper-phonemize.

	  https://github.com/csukuangfj/piper-phonemize

comment "piper-phonemize needs an x86-64 glibc toolchain with C++ and threads"
	depends on !BR2_x86_64 || !BR2_TOOLCHAIN_USES_GLIBC || !BR2_INSTALL_LIBSTDCPP || !BR2_TOOLCHAIN_HAS_THREADS
```

## os/package/pocketsphinx/Config.in
```kconfig
config BR2_PACKAGE_POCKETSPHINX
	bool "PocketSphinx streaming English recognizer"
	depends on !BR2_STATIC_LIBS
	help
	  Local keyword spotting, endpointing, and streaming recognition.

	  https://github.com/cmusphinx/pocketsphinx
```

## os/package/sherpa-onnx/Config.in
```kconfig
config BR2_PACKAGE_SHERPA_ONNX
	bool "sherpa-onnx"
	depends on BR2_x86_64
	depends on BR2_TOOLCHAIN_USES_GLIBC
	depends on BR2_INSTALL_LIBSTDCPP
	depends on BR2_TOOLCHAIN_HAS_THREADS
	help
	  The speech engine library the voice organ loads through
	  ctypes: Silero voice activity detection, Moonshine speech
	  recognition and Piper voices. This installs the upstream
	  prebuilt linux-x64-shared release (libsherpa-onnx-c-api.so and
	  its bundled ONNX Runtime 1.28.2, libonnxruntime.so), pinned by
	  sha256. It needs glibc 2.17 or newer and libstdc++.

	  ONNX Runtime chooses its CPU kernels at run time. The v2.0.2
	  no-tts build of the same runtime ran on the QEMU Ivy Bridge
	  guest (AVX, no AVX2); lab/sherpa_avx_smoke.py checks this
	  release's VAD, Moonshine and Piper the same way.

	  The library links espeak-ng (GPL-3.0-or-later) statically.
	  Licences and the Alba voice credit are installed to
	  /usr/share/licenses/sherpa-onnx.

	  https://github.com/k2-fsa/sherpa-onnx

if BR2_PACKAGE_SHERPA_ONNX

choice
	prompt "sherpa-onnx release"
	default BR2_PACKAGE_SHERPA_ONNX_V2_0_3
	help
	  Both releases have the same C API layout (mind/sherpa.py checks
	  the version it loads) and the same ONNX Runtime 1.28.2.

config BR2_PACKAGE_SHERPA_ONNX_V2_0_3
	bool "v2.0.3"

config BR2_PACKAGE_SHERPA_ONNX_V2_0_2
	bool "v2.0.2 (fallback)"
	help
	  The previous release. Its no-tts build is the one first run on
	  the Ivy Bridge QEMU guest.

endchoice

endif

comment "sherpa-onnx needs an x86-64 glibc toolchain with C++ and threads"
	depends on !BR2_x86_64 || !BR2_TOOLCHAIN_USES_GLIBC || !BR2_INSTALL_LIBSTDCPP || !BR2_TOOLCHAIN_HAS_THREADS
```

## os/package/stream-benchmark/Config.in
```kconfig
config BR2_PACKAGE_STREAM_BENCHMARK
	bool "STREAM 5.10 memory bandwidth benchmark"
	depends on BR2_USE_MMU
	depends on BR2_TOOLCHAIN_HAS_OPENMP
	help
	  The author's unmodified STREAM 5.10 C benchmark with OpenMP
	  workers. Set OMP_NUM_THREADS to control the worker count.

	  Results may be called STREAM results only when the author's run rules
	  are followed. PipOS does not automatically publish or compare them.

	  https://www.cs.virginia.edu/stream/
```
